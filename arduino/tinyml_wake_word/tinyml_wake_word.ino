/*
 * TinyML Wake Word Detector
 * ==========================
 * Runs a neural network on the ESP32-S3 to detect a wake word.
 *
 * Hardware:
 *   - ESP32-S3 development board (~$2 on AliExpress)
 *   - USB-C cable
 *
 * Arduino Library Required:
 *   - TensorFlowLite_ESP32 (install via Library Manager)
 *
 * Board Settings (Tools menu):
 *   - Board:            ESP32S3 Dev Module
 *   - Upload Speed:     921600
 *   - USB Mode:         Hardware CDC and JTAG
 *   - Flash Size:       4MB (or 8MB if your board supports it)
 *
 * Files needed in this sketch folder:
 *   - tinyml_wake_word.ino  (this file)
 *   - wake_model.h          (generated by python/3_make_header.py)
 *
 * Serial Monitor: 115200 baud
 *
 * Part of the article:
 * "I Put an AI Brain Inside a $2 Chip. It Actually Works."
 * github.com/[your-handle]/tinyml-esp32s3
 */

// -------------------------------------------------------
// INCLUDES
// -------------------------------------------------------
#include <TensorFlowLite_ESP32.h>
#include "wake_model.h"   // <-- our trained model as a byte array

#include "tensorflow/lite/micro/micro_interpreter.h"
#include "tensorflow/lite/micro/micro_mutable_op_resolver.h"
#include "tensorflow/lite/schema/schema_generated.h"

// -------------------------------------------------------
// CONFIGURATION — tweak these if needed
// -------------------------------------------------------

// How much memory to reserve for TFLite (the "tensor arena").
// Think of this as a whiteboard TFLite uses during inference.
// Start at 10KB. If AllocateTensors() fails, double it.
// Once working, reduce by 512 bytes at a time to find minimum.
constexpr int kTensorArenaSize = 10 * 1024;

// Decision threshold — how confident the model must be
// to call something a wake word.
// Higher = fewer false positives but may miss real wake words.
// Lower  = catches more wake words but more false alarms.
constexpr float kConfidenceThreshold = 0.80f;

// How many MFCC features our model expects
// Must match what you trained with (we used 13)
constexpr int kNumMfccFeatures = 13;

// -------------------------------------------------------
// GLOBALS
// -------------------------------------------------------
uint8_t tensor_arena[kTensorArenaSize];
tflite::MicroInterpreter* interpreter = nullptr;
bool model_ready = false;

// -------------------------------------------------------
// SETUP — runs once on power-on
// -------------------------------------------------------
void setup() {
  Serial.begin(115200);
  delay(1000);  // Let serial connection stabilize

  printBanner();
  model_ready = loadModel();

  if (model_ready) {
    Serial.println("✅ Ready. Running inference every 2 seconds.");
    Serial.println("   (Replace dummy input with real mic data for live detection)");
    Serial.println();
  } else {
    Serial.println("❌ Setup failed. Check errors above and reset.");
  }
}

// -------------------------------------------------------
// LOOP — runs forever after setup()
// -------------------------------------------------------
void loop() {
  if (!model_ready) {
    delay(5000);
    return;
  }

  // ----- GET INPUT DATA -----
  // In production: replace this with real MFCC features from a microphone.
  // In this demo: we use 0.5 for all features as a placeholder.
  // See README.md for how to wire up the INMP441 microphone (Part 2).
  float mfcc_features[kNumMfccFeatures];
  getDummyMfccFeatures(mfcc_features);

  // ----- RUN INFERENCE -----
  float confidence = runInference(mfcc_features);

  // ----- INTERPRET RESULT -----
  if (confidence < 0.0f) {
    Serial.println("⚠️  Inference failed — skipping this frame");
  } else {
    printResult(confidence);
  }

  delay(2000);  // In production: run every ~100ms for real-time detection
}

// -------------------------------------------------------
// loadModel()
// Loads the TFLite model from flash, sets up the interpreter.
// Returns true on success, false on any error.
// -------------------------------------------------------
bool loadModel() {
  Serial.println("Loading model from flash...");

  // Point to the model byte array embedded in wake_model.h
  const tflite::Model* model = tflite::GetModel(wake_model_tflite);

  // Schema version check — catches TF version mismatches early
  if (model->version() != TFLITE_SCHEMA_VERSION) {
    Serial.println("❌ Model schema version mismatch!");
    Serial.printf("   Model: %d  |  Expected: %d\n",
                  model->version(), TFLITE_SCHEMA_VERSION);
    Serial.println("   Fix: retrain with a TensorFlow version that matches");
    Serial.println("   the TensorFlowLite_ESP32 library version.");
    return false;
  }

  // -------------------------------------------------------
  // OP RESOLVER
  // Register only the mathematical operations our model uses.
  // Using AllOpsResolver compiles ALL TFLite ops (~300KB extra flash).
  // MicroMutableOpResolver only compiles what you explicitly add.
  //
  // To find which ops your model uses:
  //   1. Open wake_model.tflite at netron.app (free, browser-based)
  //   2. Look at each layer's type
  //   3. Add the matching resolver.Add___() call below
  // -------------------------------------------------------
  static tflite::MicroMutableOpResolver<3> resolver;
  resolver.AddFullyConnected();  // Dense layers
  resolver.AddRelu();            // relu activations
  resolver.AddLogistic();        // sigmoid output layer

  // Create the interpreter
  static tflite::MicroInterpreter static_interpreter(
    model, resolver, tensor_arena, kTensorArenaSize
  );
  interpreter = &static_interpreter;

  // Allocate memory for input/output tensors
  TfLiteStatus alloc_status = interpreter->AllocateTensors();
  if (alloc_status != kTfLiteOk) {
    Serial.println("❌ AllocateTensors() failed!");
    Serial.printf("   Current arena: %d bytes. Try doubling kTensorArenaSize.\n",
                  kTensorArenaSize);
    return false;
  }

  // Report memory usage
  size_t used_bytes = interpreter->arena_used_bytes();
  Serial.printf("✅ Model loaded. Arena used: %d / %d bytes\n",
                used_bytes, kTensorArenaSize);

  return true;
}

// -------------------------------------------------------
// runInference()
// Feeds MFCC features into the model and returns a confidence
// score between 0.0 (silence) and 1.0 (wake word).
// Returns -1.0 on error.
// -------------------------------------------------------
float runInference(float* mfcc_features) {
  // Write features into the model's input tensor
  float* input = interpreter->input(0)->data.f;
  for (int i = 0; i < kNumMfccFeatures; i++) {
    input[i] = mfcc_features[i];
  }

  // Run the neural network
  TfLiteStatus run_status = interpreter->Invoke();
  if (run_status != kTfLiteOk) {
    Serial.println("❌ Invoke() failed — model did not run");
    return -1.0f;
  }

  // Read the output (single float between 0.0 and 1.0)
  return interpreter->output(0)->data.f[0];
}

// -------------------------------------------------------
// getDummyMfccFeatures()
// Fills an array with placeholder values for testing.
// Replace this function with real microphone + MFCC extraction
// for live wake word detection (covered in Part 2).
// -------------------------------------------------------
void getDummyMfccFeatures(float* features) {
  for (int i = 0; i < kNumMfccFeatures; i++) {
    features[i] = 0.5f;
  }
}

// -------------------------------------------------------
// printResult()
// Formats and prints the inference result to Serial Monitor.
// -------------------------------------------------------
void printResult(float confidence) {
  Serial.printf("Confidence: %.4f  |  ", confidence);

  if (confidence >= kConfidenceThreshold) {
    Serial.println(">> WAKE WORD DETECTED! <<");
  } else {
    Serial.println("-- Background noise --");
  }
}

// -------------------------------------------------------
// printBanner()
// Startup message with key config info.
// -------------------------------------------------------
void printBanner() {
  Serial.println();
  Serial.println("╔══════════════════════════════════════╗");
  Serial.println("║   TinyML Wake Word Detector v1.0     ║");
  Serial.println("║   ESP32-S3 + TensorFlow Lite Micro   ║");
  Serial.println("╚══════════════════════════════════════╝");
  Serial.printf("Tensor arena:  %d bytes\n", kTensorArenaSize);
  Serial.printf("MFCC features: %d\n", kNumMfccFeatures);
  Serial.printf("Threshold:     %.2f\n", kConfidenceThreshold);
  Serial.println();
}
